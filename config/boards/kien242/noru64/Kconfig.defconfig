## config/boards/kien242/noru64/Kconfig.defconfig
```kconfig
#
# Copyright (c) 2021 The ZMK Contributors
# SPDX-License-Identifier: MIT
#

if BOARD_NORU64_V1_LEFT

config ZMK_KEYBOARD_NAME
    default "Noru64 v1"

config ZMK_SPLIT_ROLE_CENTRAL
    default y

endif # BOARD_NORU64_V1_LEFT

if BOARD_NORU64_V1_RIGHT

config ZMK_KEYBOARD_NAME
    default "Noru64 v1 R"

endif # BOARD_NORU64_V1_RIGHT

if BOARD_NORU64_V1_LEFT || BOARD_NORU64_V1_RIGHT

config BOARD
    default "noru64"

config ZMK_SPLIT
    default y

config BT_CTLR
    default BT

config PINCTRL
    default y

if USB

config USB_NRFX
    default y

config USB_DEVICE_STACK
    default y

endif # USB

endif # BOARD_NORU64_V1_LEFT || BOARD_NORU64_V1_RIGHT
```

## config/boards/kien242/noru64/Kconfig.noru64
```kconfig
#
# Copyright (c) 2021 The ZMK Contributors
# SPDX-License-Identifier: MIT
#

config BOARD_NORU64_V1_LEFT
    select SOC_NRF52840_QIAA
    select ZMK_BOARD_COMPAT
    imply RETAINED_MEM
    imply RETENTION
    imply RETENTION_BOOT_MODE

config BOARD_NORU64_V1_RIGHT
    select SOC_NRF52840_QIAA
    select ZMK_BOARD_COMPAT
    imply RETAINED_MEM
    imply RETENTION
    imply RETENTION_BOOT_MODE
```

## config/boards/kien242/noru64/board.yml
```yaml
boards:
  - name: noru64_v1_left
    vendor: kien242
    socs:
      - name: nrf52840
        variants:
          - name: zmk
  - name: noru64_v1_right
    vendor: kien242
    socs:
      - name: nrf52840
        variants:
          - name: zmk
```

## config/boards/kien242/noru64/noru64_v1_left_nrf52840_zmk_defconfig
```kconfig
#
# Copyright (c) 2021 The ZMK Contributors
# SPDX-License-Identifier: MIT
#

# Enable MPU
CONFIG_ARM_MPU=y

# Use pinctrl
CONFIG_PINCTRL=y

# Enable GPIO
CONFIG_GPIO=y

# Enable writing to flash
CONFIG_USE_DT_CODE_PARTITION=y
CONFIG_BUILD_OUTPUT_UF2=y
CONFIG_MPU_ALLOW_FLASH_WRITE=y
CONFIG_NVS=y
CONFIG_SETTINGS_NVS=y
CONFIG_FLASH=y
CONFIG_FLASH_PAGE_LAYOUT=y
CONFIG_FLASH_MAP=y

# Enable external 32kHz crystal
CONFIG_CLOCK_CONTROL_NRF_K32SRC_XTAL=y
CONFIG_CLOCK_CONTROL_NRF_K32SRC_30PPM=y

# USB HID
CONFIG_ZMK_USB=y

# BLE HID
CONFIG_ZMK_BLE=y

# RGB underglow (selects LED_STRIP and SPI automatically)
CONFIG_ZMK_RGB_UNDERGLOW=y
CONFIG_ZMK_RGB_UNDERGLOW_EXT_POWER=n
CONFIG_ZMK_RGB_UNDERGLOW_ON_START=n
```

## config/boards/kien242/noru64/noru64_v1_right_nrf52840_zmk_defconfig
```kconfig
#
# Copyright (c) 2021 The ZMK Contributors
# SPDX-License-Identifier: MIT
#

# Enable MPU
CONFIG_ARM_MPU=y

# Use pinctrl
CONFIG_PINCTRL=y

# Enable GPIO
CONFIG_GPIO=y

# Enable writing to flash
CONFIG_USE_DT_CODE_PARTITION=y
CONFIG_BUILD_OUTPUT_UF2=y
CONFIG_MPU_ALLOW_FLASH_WRITE=y
CONFIG_NVS=y
CONFIG_SETTINGS_NVS=y
CONFIG_FLASH=y
CONFIG_FLASH_PAGE_LAYOUT=y
CONFIG_FLASH_MAP=y

# Enable external 32kHz crystal
CONFIG_CLOCK_CONTROL_NRF_K32SRC_XTAL=y
CONFIG_CLOCK_CONTROL_NRF_K32SRC_30PPM=y

# BLE HID (peripheral half has no USB)
CONFIG_ZMK_BLE=y
```
